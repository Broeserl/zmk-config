## config/boards/shields/track_man_5x6/Kconfig.defconfig
```kconfig
if SHIELD_TRACK_MAN_5X6_LEFT

    config ZMK_KEYBOARD_NAME
        default "Track-Man-5x6-L"

endif

if SHIELD_TRACK_MAN_5X6_RIGHT

    config ZMK_KEYBOARD_NAME
        default "Track-Man-5x6-R"

    config ZMK_SPLIT_BLE_ROLE_CENTRAL
        default y

endif

if SHIELD_TRACK_MAN_5X6_LEFT || SHIELD_TRACK_MAN_5X6_RIGHT

    config ZMK_SPLIT
        default y

endif
```

## config/boards/shields/track_man_5x6/Kconfig.shield
```kconfig
config SHIELD_TRACK_MAN_5X6_LEFT
    def_bool $(shields_list_contains,track_man_5x6_left)

config SHIELD_TRACK_MAN_5X6_RIGHT
    def_bool $(shields_list_contains,track_man_5x6_right)
```
